## platform/stm32/Kconfig
```kconfig
config GEN_ADC
	string
	default gen_1 if FAMILY_STM32F1XX || FAMILY_STM32F4XX
	default gen_2 if FAMILY_STM32F0XX

config GEN_I2C
	string
	default gen_1 if FAMILY_STM32F1XX
	default gen_2 if FAMILY_STM32F0XX

config GEN_PIN
	string
	default gen_2 if FAMILY_STM32F0XX
	default stm32f1xx if FAMILY_STM32F1XX

config GEN_UART
	string
	default gen_1 if FAMILY_STM32F1XX
	default gen_2 if FAMILY_STM32F0XX

config GEN_USB
	string
	default gen_1 if FAMILY_STM32F0XX || FAMILY_STM32F1XX

config PLATFORM_STM32_PIN_REMAP
	bool
	default y if FAMILY_STM32F1XX

menu "Power settings"

config PM
	bool "Power management"
	default y
	help
	  This enables support for power management features.

endmenu

menu "Peripherals"

config PLATFORM_STM32_NO_DEINIT
	bool "Disable destructors"
	default n

config PLATFORM_STM32_ADC_BASE
	bool "ADC"
	default y

config PLATFORM_STM32_ADC_BASIC
	bool
	default y if FAMILY_STM32F1XX
	depends on PLATFORM_STM32_ADC_BASE

config PLATFORM_STM32_ADC_NO_DEINIT
	bool
	default y if PLATFORM_STM32_NO_DEINIT
	depends on PLATFORM_STM32_ADC_BASE

config PLATFORM_STM32_ADC_PRIORITY
	int "ADC interrupts priority"
	default 0
	depends on PLATFORM_STM32_ADC_BASE

config PLATFORM_STM32_ADC_SHARED
	bool "Shared ADC"
	default y
	depends on PLATFORM_STM32_ADC_BASE
	help
	  This allows usage of multiple ADC channel objects on the same peripheral.

config PLATFORM_STM32_ADC
	bool "Multichannel ADC with interrupts"
	default y
	depends on PLATFORM_STM32_ADC_BASE && (FAMILY_STM32F1XX || FAMILY_STM32F4XX)

config PLATFORM_STM32_ADC_DMA
	bool "Multichannel ADC with DMA"
	default y
	depends on PLATFORM_STM32_ADC_BASE && (PLATFORM_STM32_BDMA || PLATFORM_STM32_DMA)

config PLATFORM_STM32_BDMA
	bool "Basic DMA"
	default y
	depends on FAMILY_STM32F0XX || FAMILY_STM32F1XX

config PLATFORM_STM32_BDMA_PRIORITY
	int "Basic DMA interrupts priority"
	default 0
	depends on PLATFORM_STM32_BDMA

config PLATFORM_STM32_CAN
	bool "bxCAN"
	default y
	help
	  This is the driver for the Controller Area Network peripheral.

config PLATFORM_STM32_CAN_NO_DEINIT
	bool
	default y if PLATFORM_STM32_NO_DEINIT
	depends on PLATFORM_STM32_CAN

config PLATFORM_STM32_CAN_COUNTERS
	bool "Frame counters"
	default y
	depends on PM && PLATFORM_STM32_CAN

config PLATFORM_STM32_CAN_EXACT_RATE
	bool "Exact rate"
	default y
	depends on PM && PLATFORM_STM32_CAN

config PLATFORM_STM32_CAN_PM
	bool "Power management"
	default n
	depends on PM && PLATFORM_STM32_CAN

config PLATFORM_STM32_CAN_SJW
	int "SJW duration"
	default 1
	range 1 4
	depends on PLATFORM_STM32_CAN

config PLATFORM_STM32_CAN_SP
	int "Sampling point"
	default 75
	range 1 99
	depends on PLATFORM_STM32_CAN
	help
	  The sample point is the location, given as a percent value,
	  inside each bit period where the bus level is read.

config PLATFORM_STM32_CAN_WATERMARK
	bool "Watermark calculation"
	default n
	depends on PLATFORM_STM32_CAN

config PLATFORM_STM32_DMA
	bool "DMA"
	default n

config PLATFORM_STM32_DMA_PRIORITY
	int "DMA interrupts priority"
	default 0
	depends on PLATFORM_STM32_DMA

config PLATFORM_STM32_EXTI
	bool "EXTI"
	default y
	help
	  This is the driver for the Extended Interrupts and Events Controller.

config PLATFORM_STM32_EXTI_NO_DEINIT
	bool
	default y if PLATFORM_STM32_NO_DEINIT
	depends on PLATFORM_STM32_EXTI

config PLATFORM_STM32_GPTIMER_BASE
	bool "General Purpose Timer"
	default y

config PLATFORM_STM32_GPTIMER_NO_DEINIT
	bool
	default y if PLATFORM_STM32_NO_DEINIT
	depends on PLATFORM_STM32_GPTIMER_BASE

config PLATFORM_STM32_GPTIMER_PM
	bool "Power management"
	default n
	depends on PLATFORM_STM32_GPTIMER_BASE && PM

config PLATFORM_STM32_GPTIMER
	bool "Common timer"
	default y
	depends on PLATFORM_STM32_GPTIMER_BASE

config PLATFORM_STM32_I2C_BASE
	bool "I2C"
	default y

config PLATFORM_STM32_I2C_NO_DEINIT
	bool
	default y if PLATFORM_STM32_NO_DEINIT
	depends on PLATFORM_STM32_I2C_BASE

config PLATFORM_STM32_I2C_PM
	bool "Power management"
	default n
	depends on PM && PLATFORM_STM32_I2C_BASE

config PLATFORM_STM32_I2C
	bool "I2C Master with DMA"
	default y
	depends on PLATFORM_STM32_I2C_BASE && (PLATFORM_STM32_BDMA || PLATFORM_STM32_DMA)

config PLATFORM_STM32_IWDG
	bool "IWDG"
	default y

config PLATFORM_STM32_SPI_BASE
	bool "SPI"
	default y
	help
	  This is the driver for the Serial Peripheral Interface.

config PLATFORM_STM32_SPI_NO_DEINIT
	bool
	default y if PLATFORM_STM32_NO_DEINIT
	depends on PLATFORM_STM32_SPI_BASE

config PLATFORM_STM32_SPI_RC
	bool "Runtime configuration"
	default y
	depends on PLATFORM_STM32_SPI_BASE

config PLATFORM_STM32_SPI
	bool "SPI Master with DMA"
	default y
	depends on PLATFORM_STM32_SPI_BASE && (PLATFORM_STM32_BDMA || PLATFORM_STM32_DMA)

config PLATFORM_STM32_UART_BASE
	bool "UART"
	default y

config PLATFORM_STM32_UART_NO_DEINIT
	bool
	default y if PLATFORM_STM32_NO_DEINIT
	depends on PLATFORM_STM32_UART_BASE

config PLATFORM_STM32_UART_PM
	bool "Power management"
	default n
	depends on PM && PLATFORM_STM32_UART_BASE

config PLATFORM_STM32_UART_RC
	bool "Runtime configuration"
	default y
	depends on PLATFORM_STM32_UART_BASE

config PLATFORM_STM32_UART_WATERMARK
	bool "Watermark calculation"
	default n
	depends on PLATFORM_STM32_UART_BASE

config PLATFORM_STM32_SERIAL
	bool "Interrupt-driven serial port driver"
	default y
	depends on PLATFORM_STM32_UART_BASE

config PLATFORM_STM32_SERIAL_DMA
	bool "Serial port driver with DMA"
	default y
	depends on PLATFORM_STM32_UART_BASE && (PLATFORM_STM32_BDMA || PLATFORM_STM32_DMA)

config PLATFORM_STM32_SERIAL_DMA_PRIORITY
	int "UART IDLE interrupt priority"
	default 0
	depends on PLATFORM_STM32_SERIAL_DMA && PLATFORM_STM32_BDMA && PLATFORM_STM32_DMA

config PLATFORM_USB
	bool "USB"
	default y
	depends on FAMILY_STM32F0XX || FAMILY_STM32F1XX

config PLATFORM_USB_NO_DEINIT
	bool
	default y if PLATFORM_STM32_NO_DEINIT
	depends on PLATFORM_USB

config PLATFORM_USB_DEVICE
	bool "USB Device"
	default y
	depends on PLATFORM_USB

config PLATFORM_USB_DOUBLE_BUFFERING
	bool "Double-buffered endpoints"
	default y
	depends on PLATFORM_USB && (FAMILY_STM32F0XX || FAMILY_STM32F1XX)

config PLATFORM_USB_DEVICE_EP_REQUESTS
	int "Endpoint queue size"
	default 4
	depends on PLATFORM_USB_DEVICE

endmenu

if FAMILY_STM32F0XX
	source "platform/stm32/stm32f0xx/Kconfig"
endif

if FAMILY_STM32F1XX
	source "platform/stm32/stm32f1xx/Kconfig"
endif
```

## platform/stm32/stm32f0xx/Kconfig
```kconfig
menu "Enabled peripherals"

menu "Basic DMA Controllers"

config PLATFORM_STM32_BDMA1
	bool "BDMA1"
	default y
	depends on PLATFORM_STM32_BDMA

config PLATFORM_STM32_BDMA2
	bool "BDMA2"
	default n
	depends on PLATFORM_STM32_BDMA

endmenu

menu "I2C"

config PLATFORM_STM32_I2C1
	bool "I2C1"
	default y
	depends on PLATFORM_STM32_I2C_BASE

config PLATFORM_STM32_I2C2
	bool "I2C2"
	default y
	depends on PLATFORM_STM32_I2C_BASE

endmenu

menu "General Purpose Timers"

config PLATFORM_STM32_TIM1
	bool "TIM1"
	default y
	depends on PLATFORM_STM32_GPTIMER_BASE

config PLATFORM_STM32_TIM2
	bool "TIM2"
	default y
	depends on PLATFORM_STM32_GPTIMER_BASE

config PLATFORM_STM32_TIM3
	bool "TIM3"
	default y
	depends on PLATFORM_STM32_GPTIMER_BASE

config PLATFORM_STM32_TIM6
	bool "TIM6"
	default y
	depends on PLATFORM_STM32_GPTIMER_BASE
	help
	  TIM6 is available on STM32F05x, STM32F07x and STM32F09x devices only.

config PLATFORM_STM32_TIM7
	bool "TIM7"
	default y
	depends on PLATFORM_STM32_GPTIMER_BASE
	help
	  TIM7 is available on STM32F07x and STM32F09x devices only.

config PLATFORM_STM32_TIM14
	bool "TIM14"
	default y
	depends on PLATFORM_STM32_GPTIMER_BASE

config PLATFORM_STM32_TIM15
	bool "TIM15"
	default y
	depends on PLATFORM_STM32_GPTIMER_BASE
	help
	  TIM15 is not available on STM32F03x devices.

config PLATFORM_STM32_TIM16
	bool "TIM16"
	default y
	depends on PLATFORM_STM32_GPTIMER_BASE

config PLATFORM_STM32_TIM17
	bool "TIM17"
	default y
	depends on PLATFORM_STM32_GPTIMER_BASE

endmenu

menu "SPI"

config PLATFORM_STM32_SPI1
	bool "SPI1"
	default y
	depends on PLATFORM_STM32_SPI_BASE

config PLATFORM_STM32_SPI2
	bool "SPI2"
	default y
	depends on PLATFORM_STM32_SPI_BASE
	help
	  SPI2 is available on STM32F04x, STM32F05x, STM32F07x and
	  STM32F09x devices only.

endmenu

menu "UART"

config PLATFORM_STM32_USART1
	bool "USART1"
	default y
	depends on PLATFORM_STM32_UART_BASE

config PLATFORM_STM32_USART2
	bool "USART2"
	default y
	depends on PLATFORM_STM32_UART_BASE
	help
	  USART2 is available on STM32F04x, STM32F05x, STM32F07x
	  and STM32F09x devices only.

config PLATFORM_STM32_USART3
	bool "USART3"
	default y
	depends on PLATFORM_STM32_UART_BASE
	help
	  USART3 is available on STM32F07x and STM32F09x devices only.

config PLATFORM_STM32_USART4
	bool "USART4"
	default y
	depends on PLATFORM_STM32_UART_BASE
	help
	  USART4 is available on STM32F07x and STM32F09x devices only.

config PLATFORM_STM32_USART5
	bool "USART5"
	default y
	depends on PLATFORM_STM32_UART_BASE
	help
	  USART5 is available on STM32F09x devices only.

config PLATFORM_STM32_USART6
	bool "USART6"
	default y
	depends on PLATFORM_STM32_UART_BASE
	help
	  USART6 is available on STM32F09x devices only.

config PLATFORM_STM32_USART7
	bool "USART7"
	default y
	depends on PLATFORM_STM32_UART_BASE
	help
	  USART7 is available on STM32F09x devices only.

config PLATFORM_STM32_USART8
	bool "USART8"
	default y
	depends on PLATFORM_STM32_UART_BASE
	help
	  USART8 is available on STM32F09x devices only.

endmenu

endmenu
```
