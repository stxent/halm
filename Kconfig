## platform/lpc/Kconfig
```kconfig
config GEN_ADC
	string
	default "gen_1" if FAMILY_LPC11XX || FAMILY_LPC11EXX || FAMILY_LPC13XX || FAMILY_LPC13UXX || FAMILY_LPC17XX || FAMILY_LPC43XX
	default "gen_2" if FAMILY_LPC82X

config GEN_BOD
	string
	default "gen_1" if FAMILY_LPC82X || FAMILY_LPC11XX || FAMILY_LPC11EXX || FAMILY_LPC13XX || FAMILY_LPC13UXX
	default "lpc17xx" if FAMILY_LPC17XX
	default "lpc43xx" if FAMILY_LPC43XX

config GEN_CAN
	string
	default "gen_1" if FAMILY_LPC17XX
	default "gen_2" if FAMILY_LPC11EXX || FAMILY_LPC43XX

config GEN_CLOCK
	string
	default "gen_2" if FAMILY_LPC11XX || FAMILY_LPC11EXX || FAMILY_LPC13XX || FAMILY_LPC13UXX
	default "lpc17xx" if FAMILY_LPC17XX
	default "lpc43xx" if FAMILY_LPC43XX

config GEN_DAC
	string
	default "gen_1" if FAMILY_LPC17XX || FAMILY_LPC43XX

config GEN_FLASH
	string
	default "gen_1" if FAMILY_LPC82X || FAMILY_LPC11EXX || FAMILY_LPC11XX || FAMILY_LPC13XX || FAMILY_LPC13UXX || FAMILY_LPC17XX
	default "lpc43xx" if FAMILY_LPC43XX

config GEN_I2C
	string
	default "gen_1" if FAMILY_LPC11XX || FAMILY_LPC11EXX || FAMILY_LPC13XX || FAMILY_LPC13UXX || FAMILY_LPC17XX || FAMILY_LPC43XX
	default "gen_2" if FAMILY_LPC82X

config GEN_PIN
	string
	default "gen_2" if FAMILY_LPC11XX || FAMILY_LPC13XX
	default "gen_3" if FAMILY_LPC11EXX || FAMILY_LPC13UXX
	default "lpc82x" if FAMILY_LPC82X
	default "lpc17xx" if FAMILY_LPC17XX
	default "lpc43xx" if FAMILY_LPC43XX

config GEN_PINBUS
	string
	default "gen_2" if FAMILY_LPC11XX || FAMILY_LPC13XX
	default "gen_3" if FAMILY_LPC82X || FAMILY_LPC11EXX || FAMILY_LPC13UXX || FAMILY_LPC43XX
	default "lpc17xx" if FAMILY_LPC17XX

config GEN_PININT
	string
	default "gen_2" if FAMILY_LPC11XX || FAMILY_LPC13XX
	default "gen_3" if FAMILY_LPC82X || FAMILY_LPC11EXX || FAMILY_LPC13UXX || FAMILY_LPC43XX
	default "lpc17xx" if FAMILY_LPC17XX

config GEN_RTC
	string
	default "gen_1" if FAMILY_LPC17XX || FAMILY_LPC43XX

config GEN_SPI
	string
	default "gen_1" if FAMILY_LPC11XX || FAMILY_LPC11EXX || FAMILY_LPC13XX || FAMILY_LPC13UXX || FAMILY_LPC17XX || FAMILY_LPC43XX
	default "gen_2" if FAMILY_LPC82X

config GEN_UART
	string
	default "gen_1" if FAMILY_LPC11XX || FAMILY_LPC11EXX || FAMILY_LPC13XX || FAMILY_LPC13UXX || FAMILY_LPC17XX || FAMILY_LPC43XX
	default "gen_2" if FAMILY_LPC82X

menu "Power settings"

config PM
	bool "Power management"
	default y
	help
	  This enables support for power management features.

config PLATFORM_LPC_PM_DISABLE_BOD
	bool "Disable brownout detection"
	default n
	depends on FAMILY_LPC11XX || FAMILY_LPC11EXX || FAMILY_LPC13XX || FAMILY_LPC13UXX
	help
	  This allows to disable brownout detection in suspend state.

config PLATFORM_LPC_PM_DISABLE_WDT
	bool "Disable watchdog"
	default n
	depends on FAMILY_LPC11XX || FAMILY_LPC11EXX || FAMILY_LPC13XX || FAMILY_LPC13UXX
	help
	  This allows to disable watchdog timer in suspend state.

choice
	prompt "Power-down mode in suspend state"
	default PLATFORM_LPC_PM_DEEPSLEEP
	depends on PM

	config PLATFORM_LPC_PM_DEEPSLEEP
		bool "Deep Sleep"

	config PLATFORM_LPC_PM_PD
		bool "Power-down"
		depends on FAMILY_LPC11EXX || FAMILY_LPC13UXX || FAMILY_LPC17XX || FAMILY_LPC43XX

	config PLATFORM_LPC_PM_PD_M0SUB
		bool "Power-down with M0SUB SRAM retention"
		depends on FAMILY_LPC43XX
endchoice

endmenu

menu "Peripherals"

config PLATFORM_LPC_NO_DEINIT
	bool "Disable destructors"
	default n

config PLATFORM_LPC_ADC_BASE
	bool "ADC"
	default y

config PLATFORM_LPC_ADC_NO_DEINIT
	bool
	default y if PLATFORM_LPC_NO_DEINIT
	depends on PLATFORM_LPC_ADC_BASE

config PLATFORM_LPC_ADC_SHARED
	bool "Shared ADC"
	default y
	depends on PLATFORM_LPC_ADC_BASE
	help
	  This allows usage of multiple ADC channel objects on the same peripheral.

config PLATFORM_LPC_ADC
	bool "Multichannel ADC with interrupts"
	default y
	depends on PLATFORM_LPC_ADC_BASE

config PLATFORM_LPC_ADC_DMA
	bool "Multichannel ADC with DMA"
	default y
	depends on PLATFORM_LPC_ADC_BASE && PLATFORM_LPC_GPDMA

config PLATFORM_LPC_ADC_DMA_STREAM
	bool "Multichannel buffered ADC with DMA"
	default y
	depends on PLATFORM_LPC_ADC_BASE && PLATFORM_LPC_GPDMA

config PLATFORM_LPC_ADC_ONESHOT
	bool "Multichannel ADC with polling"
	default y
	depends on PLATFORM_LPC_ADC_BASE

config PLATFORM_LPC_ATIMER
	bool "Alarm Timer"
	default y
	depends on FAMILY_LPC43XX

config PLATFORM_LPC_ATIMER_NO_DEINIT
	bool
	default y if PLATFORM_LPC_NO_DEINIT
	depends on PLATFORM_LPC_ATIMER

config PLATFORM_LPC_BOD
	bool "Brownout detection"
	default y
	select PLATFORM_LPC_EVENT_ROUTER if FAMILY_LPC43XX

config PLATFORM_LPC_BOD_NO_DEINIT
	bool
	default y if PLATFORM_LPC_NO_DEINIT
	depends on PLATFORM_LPC_BOD

config PLATFORM_LPC_CAN
	bool "CAN"
	default y
	depends on FAMILY_LPC17XX || FAMILY_LPC43XX

config PLATFORM_LPC_CAN_NO_DEINIT
	bool
	default y if PLATFORM_LPC_NO_DEINIT
	depends on PLATFORM_LPC_CAN

config PLATFORM_LPC_CAN_COUNTERS
	bool "Frame counters"
	default y
	depends on PM && PLATFORM_LPC_CAN

config PLATFORM_LPC_CAN_EXACT_RATE
	bool "Exact rate"
	default y
	depends on PM && PLATFORM_LPC_CAN

config PLATFORM_LPC_CAN_FILTERS
	bool "Filtering"
	default y
	depends on PLATFORM_LPC_CAN && FAMILY_LPC43XX

config PLATFORM_LPC_CAN_PM
	bool "Power management"
	default n
	depends on PM && PLATFORM_LPC_CAN

config PLATFORM_LPC_CAN_SJW
	int "SJW duration"
	default 1
	range 1 4
	depends on PLATFORM_LPC_CAN

config PLATFORM_LPC_CAN_SP
	int "Sampling point"
	default 75
	range 1 99
	depends on PLATFORM_LPC_CAN
	help
	  The sample point is the location, given as a percent value,
	  inside each bit period where the bus level is read.

config PLATFORM_LPC_CAN_WATERMARK
	bool "Watermark calculation"
	default n
	depends on PLATFORM_LPC_CAN

config PLATFORM_LPC_DAC_BASE
	bool "DAC"
	default y
	depends on FAMILY_LPC17XX || FAMILY_LPC43XX

config PLATFORM_LPC_DAC_NO_DEINIT
	bool
	default y if PLATFORM_LPC_NO_DEINIT
	depends on PLATFORM_LPC_DAC_BASE

config PLATFORM_LPC_DAC
	bool "Simplified DAC driver"
	default y
	depends on PLATFORM_LPC_DAC_BASE

config PLATFORM_LPC_DAC_DMA
	bool "DAC driver with DMA"
	default y
	depends on PLATFORM_LPC_DAC_BASE && PLATFORM_LPC_GPDMA

config PLATFORM_LPC_EEPROM
	bool "EEPROM"
	default y
	depends on FAMILY_LPC11EXX || FAMILY_LPC13UXX || FAMILY_LPC43XX
	select PLATFORM_LPC_IAP if FAMILY_LPC11EXX || FAMILY_LPC13UXX
	help
	  This enables driver for the internal EEPROM memory.

config PLATFORM_LPC_EMC
	bool "EMC"
	default y
	depends on FAMILY_LPC43XX
	help
	  This enables driver for the External Memory Controller.

config PLATFORM_LPC_EMC_NO_DEINIT
	bool
	default y if PLATFORM_LPC_NO_DEINIT
	depends on PLATFORM_LPC_EMC

config PLATFORM_LPC_EMC_CLOCK_DIV
	bool "EMC clock division"
	default y
	depends on PLATFORM_LPC_EMC
	help
	  Enable EMC clock division by 2. Clock division is required
	  when the core clock frequency exceeds the maximum interface or memory
	  clock frequency.

config PLATFORM_LPC_ETHERNET
	bool "Ethernet"
	default y
	depends on FAMILY_LPC43XX
	help
	  This enables driver for the Ethernet MAC.

config PLATFORM_LPC_EVENT_ROUTER
	bool "Event Router"
	default y
	depends on FAMILY_LPC43XX
	help
	  This enables driver for the Event Router.

config PLATFORM_LPC_EVENT_ROUTER_PRIORITY
	int "Event Router interrupts priority"
	default 0
	depends on PLATFORM_LPC_EVENT_ROUTER

config PLATFORM_LPC_FAST_GPIO_BUS
	bool "Fast GPIO Bus"
	default y
	help
	  Optimized version of GPIO Bus for contiguous sets of pins.

config PLATFORM_LPC_FLASH
	bool "Flash driver"
	default y
	select PLATFORM_LPC_IAP
	help
	  This enables driver for the internal Flash memory.

config PLATFORM_LPC_GPDMA
	bool "GPDMA"
	default y
	depends on FAMILY_LPC17XX || FAMILY_LPC43XX

config PLATFORM_LPC_GPDMA_PRIORITY
	int "GPDMA interrupts priority"
	default 0
	depends on PLATFORM_LPC_GPDMA

config PLATFORM_LPC_GPDMA_SYNC
	bool "GPDMA synchronization"
	default y
	depends on PLATFORM_LPC_GPDMA
	help
	  Synchronization logic must be enabled when peripherals
	  generating DMA requests run on different clocks to the GPDMA.
	  For peripherals running on the same clock as the GPDMA,
	  disabling the synchronization logic improves the DMA request
	  response time.

config PLATFORM_LPC_GPTIMER_BASE
	bool "General Purpose Timer"
	default y
	depends on !FAMILY_LPC82X

config PLATFORM_LPC_GPTIMER_NO_DEINIT
	bool
	default y if PLATFORM_LPC_NO_DEINIT
	depends on PLATFORM_LPC_GPTIMER_BASE

config PLATFORM_LPC_GPTIMER_PM
	bool "Power management"
	default n
	depends on PLATFORM_LPC_GPTIMER_BASE && PM

config PLATFORM_LPC_GPTIMER
	bool "Common timer"
	default y
	depends on PLATFORM_LPC_GPTIMER_BASE

config PLATFORM_LPC_GPTIMER_CAPTURE
	bool "Input capture"
	default y
	depends on PLATFORM_LPC_GPTIMER_BASE

config PLATFORM_LPC_GPTIMER_COUNTER
	bool "Pulse counter"
	default y
	depends on PLATFORM_LPC_GPTIMER_BASE

config PLATFORM_LPC_GPTIMER_PWM
	bool "PWM"
	default y
	depends on PLATFORM_LPC_GPTIMER_BASE && (FAMILY_LPC11XX || FAMILY_LPC11EXX || FAMILY_LPC13XX || FAMILY_LPC13UXX)

config PLATFORM_LPC_GPPWM
	bool "General Purpose PWM"
	default y
	depends on FAMILY_LPC17XX

config PLATFORM_LPC_GPPWM_PM
	bool "Power management"
	default n
	depends on PLATFORM_LPC_GPPWM && PM

config PLATFORM_LPC_GPPWM_NO_DEINIT
	bool
	default y if PLATFORM_LPC_NO_DEINIT
	depends on PLATFORM_LPC_GPPWM

config PLATFORM_LPC_I2C_BASE
	bool "I2C"
	default y

config PLATFORM_LPC_I2C_NO_DEINIT
	bool
	default y if PLATFORM_LPC_NO_DEINIT
	depends on PLATFORM_LPC_I2C_BASE

config PLATFORM_LPC_I2C_PM
	bool "Power management"
	default n
	depends on PM && PLATFORM_LPC_I2C_BASE

config PLATFORM_LPC_I2C_RC
	bool "Runtime configuration"
	default y
	depends on PLATFORM_LPC_I2C_BASE

config PLATFORM_LPC_I2C_RECOVERY
	bool "Bus recovery"
	default y
	depends on PLATFORM_LPC_I2C_BASE
	help
	  This enables I2C bus recovery interface accessible through
	  a specific I2C parameter.

config PLATFORM_LPC_I2C
	bool "I2C Master"
	default y
	depends on PLATFORM_LPC_I2C_BASE

config PLATFORM_LPC_I2C_SLAVE
	bool "I2C Slave"
	default y
	depends on PLATFORM_LPC_I2C_BASE

config PLATFORM_LPC_I2S_BASE
	bool "I2S"
	default y
	depends on FAMILY_LPC17XX || FAMILY_LPC43XX

config PLATFORM_LPC_I2S_NO_DEINIT
	bool
	default y if PLATFORM_LPC_NO_DEINIT
	depends on PLATFORM_LPC_I2S_BASE

config PLATFORM_LPC_I2S_DMA
	bool "I2S driver with DMA"
	default y
	depends on PLATFORM_LPC_I2S_BASE

choice
	prompt "Master clock selection"
	default PLATFORM_LPC_I2S_128FS
	depends on PLATFORM_LPC_I2S_BASE

	config PLATFORM_LPC_I2S_128FS
		bool "128FS"

	config PLATFORM_LPC_I2S_192FS
		bool "192FS"

	config PLATFORM_LPC_I2S_256FS
		bool "256FS"

	config PLATFORM_LPC_I2S_384FS
		bool "384FS"

	config PLATFORM_LPC_I2S_512FS
		bool "512FS"
endchoice

config PLATFORM_LPC_I2S_FS
	int
	default 512 if PLATFORM_LPC_I2S_512FS
	default 384 if PLATFORM_LPC_I2S_384FS
	default 256 if PLATFORM_LPC_I2S_256FS
	default 192 if PLATFORM_LPC_I2S_192FS
	default 128
	depends on PLATFORM_LPC_I2S_BASE

config PLATFORM_LPC_IAP
	bool "IAP"
	default y
	help
	  This enables support for In-Application Programming.

config PLATFORM_LPC_PININT_BASE
	bool
	default y
	depends on PLATFORM_LPC_PININT && (FAMILY_LPC82X || FAMILY_LPC11EXX || FAMILY_LPC13UXX || FAMILY_LPC43XX)

config PLATFORM_LPC_PININT
	bool "Pin Interrupts"
	default y

config PLATFORM_LPC_PININT_NO_DEINIT
	bool
	default y if PLATFORM_LPC_NO_DEINIT
	depends on PLATFORM_LPC_PININT

config PLATFORM_LPC_RIT
	bool "Repetitive Interrupt Timer"
	default y
	depends on FAMILY_LPC13UXX || FAMILY_LPC17XX || FAMILY_LPC43XX

config PLATFORM_LPC_RIT_NO_DEINIT
	bool
	default y if PLATFORM_LPC_NO_DEINIT
	depends on PLATFORM_LPC_RIT

config PLATFORM_LPC_RTC
	bool "Real-Time Clock"
	default y
	depends on FAMILY_LPC17XX || FAMILY_LPC43XX

config PLATFORM_LPC_RTC_NO_DEINIT
	bool
	default y if PLATFORM_LPC_NO_DEINIT
	depends on PLATFORM_LPC_RTC

config PLATFORM_LPC_SDMMC
	bool "SD/MMC card interface"
	default y
	depends on FAMILY_LPC43XX
	select PLATFORM_LPC_PININT

config PLATFORM_LPC_SDMMC_PM
	bool "Power management"
	default n
	depends on PLATFORM_LPC_SDMMC && PM

config PLATFORM_LPC_SCT_BASE
	bool "SCT"
	default y
	depends on FAMILY_LPC82X || FAMILY_LPC43XX
	help
	  This is the driver for the State Configurable Timer peripheral.

config PLATFORM_LPC_SCT_NO_DEINIT
	bool
	default y if PLATFORM_LPC_NO_DEINIT
	depends on PLATFORM_LPC_SCT_BASE

config PLATFORM_LPC_SCT_PM
	bool "Power management"
	default n
	depends on PM && PLATFORM_LPC_SCT_BASE

config PLATFORM_LPC_SCT_PWM
	bool "PWM on SCT"
	default y
	depends on PLATFORM_LPC_SCT_BASE

config PLATFORM_LPC_SCT_TIMER
	bool "Common timer on SCT"
	default y
	depends on PLATFORM_LPC_SCT_BASE

config PLATFORM_LPC_SGPIO_BASE
	bool "Serial GPIO"
	default y
	depends on FAMILY_LPC43XX

config PLATFORM_LPC_SGPIO_NO_DEINIT
	bool
	default y if PLATFORM_LPC_NO_DEINIT
	depends on PLATFORM_LPC_SGPIO_BASE

config PLATFORM_LPC_SSP_BASE
	bool "SSP"
	default y
	depends on !FAMILY_LPC82X
	help
	  This is the driver for the Synchronous Serial Port peripheral.

config PLATFORM_LPC_SSP_NO_DEINIT
	bool
	default y if PLATFORM_LPC_NO_DEINIT
	depends on PLATFORM_LPC_SSP_BASE

config PLATFORM_LPC_SSP_PM
	bool "Power management"
	default n
	depends on PLATFORM_LPC_SSP_BASE && PM

config PLATFORM_LPC_SSP_RC
	bool "Runtime configuration"
	default y
	depends on PLATFORM_LPC_SSP_BASE

config PLATFORM_LPC_SPI
	bool "Interrupt-driven SPI Master"
	default y
	depends on PLATFORM_LPC_SSP_BASE

config PLATFORM_LPC_SPI_DMA
	bool "SPI Master with DMA"
	default y
	depends on PLATFORM_LPC_SSP_BASE && PLATFORM_LPC_GPDMA

config PLATFORM_LPC_SPI_DMA_CHAIN
	int "DMA chain size"
	default 1
	range 1 65536
	depends on PLATFORM_LPC_SPI_DMA

config PLATFORM_LPC_SPI_DMA_THRESHOLD
	int "DMA size threshold"
	default 8
	range 1 8
	depends on PLATFORM_LPC_SPI_DMA
	help
	  Small DMA transfers will be performed using interrupts. This is a
	  threshold value to switch from interrupt to DMA logic.

config PLATFORM_LPC_ONE_WIRE_SSP
	bool "1-Wire using SSP peripheral"
	default y
	depends on PLATFORM_LPC_SSP_BASE

config PLATFORM_LPC_ONE_WIRE_SSP_SEARCH
	bool "Device search feature"
	default y
	depends on PLATFORM_LPC_ONE_WIRE_SSP

config PLATFORM_LPC_SPIFI
	bool "SPIFI"
	default y
	depends on FAMILY_LPC43XX
	select PLATFORM_LPC_GPDMA

config PLATFORM_LPC_UART_BASE
	bool "UART"
	default y

config PLATFORM_LPC_UART_NO_DEINIT
	bool
	default y if PLATFORM_LPC_NO_DEINIT
	depends on PLATFORM_LPC_UART_BASE

config PLATFORM_LPC_UART_PM
	bool "Power management"
	default n
	depends on PM && PLATFORM_LPC_UART_BASE

config PLATFORM_LPC_UART_RC
	bool "Runtime configuration"
	default y
	depends on PLATFORM_LPC_UART_BASE

config PLATFORM_LPC_UART_WATERMARK
	bool "Watermark calculation"
	default n
	depends on PLATFORM_LPC_UART_BASE

config PLATFORM_LPC_SERIAL
	bool "Interrupt-driven serial port driver"
	default y
	depends on PLATFORM_LPC_UART_BASE

config PLATFORM_LPC_SERIAL_POLL
	bool "Serial port driver with polling"
	default y
	depends on PLATFORM_LPC_UART_BASE

config PLATFORM_LPC_SERIAL_DMA
	bool "Serial port driver with DMA"
	default y
	depends on PLATFORM_LPC_UART_BASE && PLATFORM_LPC_GPDMA

config PLATFORM_LPC_ONE_WIRE_UART
	bool "1-Wire using UART peripheral"
	default y
	depends on PLATFORM_LPC_UART_BASE

config PLATFORM_USB
	bool "USB"
	default y
	depends on FAMILY_LPC13XX || FAMILY_LPC13UXX || FAMILY_LPC17XX || FAMILY_LPC43XX
	select PLATFORM_USB_DMA if FAMILY_LPC43XX

config PLATFORM_USB_NO_DEINIT
	bool
	default y if PLATFORM_LPC_NO_DEINIT
	depends on PLATFORM_USB

config PLATFORM_USB_DMA
	bool "USB DMA"
	default y
	depends on PLATFORM_USB && (FAMILY_LPC17XX || FAMILY_LPC43XX)

config PLATFORM_USB_DOUBLE_BUFFERING
	bool "Double-buffered endpoints"
	default y
	depends on PLATFORM_USB && FAMILY_LPC13UXX

config PLATFORM_USB_HS
	bool "USB HS"
	default y
	depends on PLATFORM_USB && FAMILY_LPC43XX
	select USB_DEVICE_HS
	help
	  This enables support for USB High Speed mode.

config PLATFORM_USB_SOF
	bool "USB SOF"
	default y
	depends on PLATFORM_USB
	help
	  This enables support for USB Start of Frame events.

config PLATFORM_USB_DEVICE
	bool "USB Device"
	default y
	depends on PLATFORM_USB

config PLATFORM_USB_DEVICE_EP_REQUESTS
	int "Endpoint queue size"
	default 4
	depends on PLATFORM_USB_DEVICE && (FAMILY_LPC13XX || FAMILY_LPC13UXX || FAMILY_LPC17XX)

config PLATFORM_USB_DEVICE_POOL_SIZE
	int "Descriptor pool size"
	default 12
	depends on PLATFORM_USB_DEVICE && PLATFORM_USB_DMA

config PLATFORM_LPC_WAKEUPINT
	bool "Wake-up interrupts"
	default y
	depends on PM && (FAMILY_LPC11XX || FAMILY_LPC13XX)

config PLATFORM_LPC_WAKEUPINT_NO_DEINIT
	bool
	default y if PLATFORM_LPC_NO_DEINIT
	depends on PLATFORM_LPC_WAKEUPINT

config PLATFORM_LPC_WDT
	bool "Watchdog"
	default y

config PLATFORM_LPC_WWDT
	bool "Windowed Watchdog"
	default y
	depends on PLATFORM_LPC_WDT && !FAMILY_LPC17XX

endmenu
```
