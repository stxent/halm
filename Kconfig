## platform/numicro/Kconfig
```kconfig
config GEN_TIMER
	string
	default "gen_1" if FAMILY_M03X
	default "gen_2" if FAMILY_M48X

menu "Power settings"

config PM
	bool "Power management"
	default y
	help
	  This enables support for power management features.

choice
	prompt "Power-down mode in suspend state"
	default PLATFORM_NUMICRO_PM_PD
	depends on PM && FAMILY_M48X

	config PLATFORM_NUMICRO_PM_PD
		bool "Power-down"

	config PLATFORM_NUMICRO_PM_FWPD
		bool "Fast wake-up power-down"

	config PLATFORM_NUMICRO_PM_LLPD
		bool "Low leakage power-down"

	config PLATFORM_NUMICRO_PM_STANDBY
		bool "Standby power-down"
endchoice

choice
	prompt "SRAM retention region in shutdown state"
	default PLATFORM_NUMICRO_PM_SRAM_NONE
	depends on PLATFORM_NUMICRO_PM_STANDBY

	config PLATFORM_NUMICRO_PM_SRAM_NONE
		bool "Disabled"

	config PLATFORM_NUMICRO_PM_SRAM_16K
		bool "16K"

	config PLATFORM_NUMICRO_PM_SRAM_32K
		bool "32K"

	config PLATFORM_NUMICRO_PM_SRAM_64K
		bool "64K"

	config PLATFORM_NUMICRO_PM_SRAM_128K
		bool "128K"
endchoice

endmenu

menu "Peripherals"

config PLATFORM_NUMICRO_NO_DEINIT
	bool "Disable destructors"
	default n

config PLATFORM_NUMICRO_ADC_BASE
	bool "ADC"
	default y
	depends on FAMILY_M03X

config PLATFORM_NUMICRO_ADC_NO_DEINIT
	bool
	default y if PLATFORM_NUMICRO_NO_DEINIT
	depends on PLATFORM_NUMICRO_ADC_BASE

config PLATFORM_NUMICRO_ADC_SHARED
	bool "Shared ADC"
	default y
	depends on PLATFORM_NUMICRO_ADC_BASE
	help
	  This allows usage of multiple ADC channel objects on the same peripheral.

config PLATFORM_NUMICRO_ADC
	bool "Multichannel ADC with interrupts"
	default y
	depends on PLATFORM_NUMICRO_ADC_BASE

config PLATFORM_NUMICRO_ADC_DMA
	bool "Multichannel ADC with DMA"
	default y
	depends on PLATFORM_NUMICRO_ADC_BASE && PLATFORM_NUMICRO_PDMA

config PLATFORM_NUMICRO_BPWM_BASE
	bool "BPWM"
	default y

config PLATFORM_NUMICRO_BPWM_NO_DEINIT
	bool
	default y if PLATFORM_NUMICRO_NO_DEINIT
	depends on PLATFORM_NUMICRO_BPWM_BASE

config PLATFORM_NUMICRO_BPWM_PM
	bool "Power management"
	default n
	depends on PLATFORM_NUMICRO_BPWM_BASE && PM

config PLATFORM_NUMICRO_BPWM
	bool "Simple single edge PWM"
	default y
	depends on PLATFORM_NUMICRO_BPWM_BASE

config PLATFORM_NUMICRO_CAN
	bool "CAN"
	default y
	depends on FAMILY_M48X

config PLATFORM_NUMICRO_CAN_NO_DEINIT
	bool
	default y if PLATFORM_NUMICRO_NO_DEINIT
	depends on PLATFORM_NUMICRO_CAN

config PLATFORM_NUMICRO_CAN_COUNTERS
	bool "Frame counters"
	default y
	depends on PM && PLATFORM_NUMICRO_CAN

config PLATFORM_NUMICRO_CAN_EXACT_RATE
	bool "Exact rate"
	default y
	depends on PM && PLATFORM_NUMICRO_CAN

config PLATFORM_NUMICRO_CAN_FILTERS
	bool "Filtering"
	default y
	depends on PLATFORM_NUMICRO_CAN

config PLATFORM_NUMICRO_CAN_PM
	bool "Power management"
	default n
	depends on PM && PLATFORM_NUMICRO_CAN

config PLATFORM_NUMICRO_CAN_SJW
	int "SJW duration"
	default 1
	range 1 4
	depends on PLATFORM_NUMICRO_CAN

config PLATFORM_NUMICRO_CAN_SP
	int "Sampling point"
	default 75
	range 1 99
	depends on PLATFORM_NUMICRO_CAN
	help
	  The sample point is the location, given as a percent value,
	  inside each bit period where the bus level is read.

config PLATFORM_NUMICRO_CAN_WATERMARK
	bool "Watermark calculation"
	default n
	depends on PLATFORM_NUMICRO_CAN

config PLATFORM_NUMICRO_EADC_BASE
	bool "EADC"
	default y
	depends on FAMILY_M48X

config PLATFORM_NUMICRO_EADC_NO_DEINIT
	bool
	default y if PLATFORM_NUMICRO_NO_DEINIT
	depends on PLATFORM_NUMICRO_EADC_BASE

config PLATFORM_NUMICRO_EADC_SHARED
	bool "Shared EADC"
	default y
	depends on PLATFORM_NUMICRO_EADC_BASE
	help
	  This allows usage of multiple EADC channel objects on the same peripheral.

config PLATFORM_NUMICRO_EADC
	bool "Multichannel EADC with interrupts"
	default y
	depends on PLATFORM_NUMICRO_EADC_BASE

config PLATFORM_NUMICRO_EADC_DMA
	bool "Multichannel EADC with DMA"
	default y
	depends on PLATFORM_NUMICRO_EADC_BASE && PLATFORM_NUMICRO_PDMA

config PLATFORM_NUMICRO_FLASH
	bool "Flash driver"
	default y
	help
	  This enables driver for the internal Flash memory.

config PLATFORM_NUMICRO_GPTIMER_BASE
	bool "General Purpose Timer"
	default y

config PLATFORM_NUMICRO_GPTIMER_NO_DEINIT
	bool
	default y if PLATFORM_NUMICRO_NO_DEINIT
	depends on PLATFORM_NUMICRO_GPTIMER_BASE

config PLATFORM_NUMICRO_GPTIMER_PM
	bool "Power management"
	default n
	depends on PLATFORM_NUMICRO_GPTIMER_BASE && PM

config PLATFORM_NUMICRO_GPTIMER
	bool "Common timer"
	default y
	depends on PLATFORM_NUMICRO_GPTIMER_BASE

config PLATFORM_NUMICRO_I2C_BASE
	bool "I2C"
	default y

config PLATFORM_NUMICRO_I2C_NO_DEINIT
	bool
	default y if PLATFORM_NUMICRO_NO_DEINIT
	depends on PLATFORM_NUMICRO_I2C_BASE

config PLATFORM_NUMICRO_I2C_PM
	bool "Power management"
	default n
	depends on PLATFORM_NUMICRO_I2C_BASE && PM

config PLATFORM_NUMICRO_I2C_RC
	bool "Runtime configuration"
	default y
	depends on PLATFORM_NUMICRO_I2C_BASE

config PLATFORM_NUMICRO_I2C_RECOVERY
	bool "Bus recovery"
	default y
	depends on PLATFORM_NUMICRO_I2C_BASE
	help
	  This enables I2C bus recovery interface accessible through
	  a specific I2C parameter.

config PLATFORM_NUMICRO_I2C
	bool "I2C Master"
	default y
	depends on PLATFORM_NUMICRO_I2C_BASE

config PLATFORM_NUMICRO_PDMA
	bool "PDMA"
	default y

config PLATFORM_NUMICRO_PDMA_COUNT
	int "PDMA channel count"
	default 2
	range 2 9
	depends on PLATFORM_NUMICRO_PDMA && FAMILY_M03X

config PLATFORM_NUMICRO_PDMA_PRIORITY
	int "PDMA interrupt priority"
	default 0
	depends on PLATFORM_NUMICRO_PDMA

config PLATFORM_NUMICRO_PININT
	bool "Pin Interrupts"
	default y

config PLATFORM_NUMICRO_PININT_NO_DEINIT
	bool
	default y if PLATFORM_NUMICRO_NO_DEINIT
	depends on PLATFORM_NUMICRO_PININT

config PLATFORM_NUMICRO_UART_BASE
	bool "UART"
	default y

config PLATFORM_NUMICRO_UART_NO_DEINIT
	bool
	default y if PLATFORM_NUMICRO_NO_DEINIT
	depends on PLATFORM_NUMICRO_UART_BASE

config PLATFORM_NUMICRO_UART_PM
	bool "Power management"
	default n
	depends on PM && PLATFORM_NUMICRO_UART_BASE

config PLATFORM_NUMICRO_UART_RC
	bool "Runtime configuration"
	default y
	depends on PLATFORM_NUMICRO_UART_BASE

config PLATFORM_NUMICRO_UART_WATERMARK
	bool "Watermark calculation"
	default n
	depends on PLATFORM_NUMICRO_UART_BASE

config PLATFORM_NUMICRO_SERIAL
	bool "Interrupt-driven serial port driver"
	default y
	depends on PLATFORM_NUMICRO_UART_BASE

config PLATFORM_NUMICRO_SERIAL_DMA
	bool "Serial port driver with DMA"
	default y
	depends on PLATFORM_NUMICRO_UART_BASE && PLATFORM_NUMICRO_PDMA

config PLATFORM_NUMICRO_SERIAL_DMA_TOC
	bool "Serial port driver with timeouts and DMA"
	default y
	depends on PLATFORM_NUMICRO_UART_BASE && PLATFORM_NUMICRO_PDMA

config PLATFORM_NUMICRO_SDH
	bool "SDH"
	default y
	depends on FAMILY_M48X
	select PLATFORM_NUMICRO_PININT
	help
	  This is the driver for the Secure Digital Host Controller.

config PLATFORM_NUMICRO_SDH_NO_DEINIT
	bool
	default y if PLATFORM_NUMICRO_NO_DEINIT
	depends on PLATFORM_NUMICRO_SDH

config PLATFORM_NUMICRO_SDH_PM
	bool "Power management"
	default n
	depends on PLATFORM_NUMICRO_SDH && PM

config PLATFORM_NUMICRO_SPI_BASE
	bool "SPI"
	default y
	help
	  This is the driver for the Serial Peripheral Interface.

config PLATFORM_NUMICRO_SPI_NO_DEINIT
	bool
	default y if PLATFORM_NUMICRO_NO_DEINIT
	depends on PLATFORM_NUMICRO_SPI_BASE

config PLATFORM_NUMICRO_SPI_PM
	bool "Power management"
	default n
	depends on PLATFORM_NUMICRO_SPI_BASE && PM

config PLATFORM_NUMICRO_SPI_RC
	bool "Runtime configuration"
	default y
	depends on PLATFORM_NUMICRO_SPI_BASE

config PLATFORM_NUMICRO_SPI
	bool "Interrupt-driven SPI Master"
	default y
	depends on PLATFORM_NUMICRO_SPI_BASE

config PLATFORM_NUMICRO_SPI_DMA
	bool "SPI Master with DMA"
	default y
	depends on PLATFORM_NUMICRO_SPI_BASE && PLATFORM_NUMICRO_PDMA

config PLATFORM_NUMICRO_SPIM
	bool "SPIM"
	default y
	depends on FAMILY_M48X
	help
	  This is the driver for the SPI Master Controller.

config PLATFORM_NUMICRO_SPIM_NO_DEINIT
	bool
	default y if PLATFORM_NUMICRO_NO_DEINIT
	depends on PLATFORM_NUMICRO_SPIM

config PLATFORM_NUMICRO_QSPI_BASE
	bool "QSPI"
	default y
	help
	  This is the driver for the Quad Serial Peripheral Interface.

config PLATFORM_NUMICRO_QSPI_DDR
	bool
	default y if FAMILY_M48X
	depends on PLATFORM_NUMICRO_QSPI_BASE

config PLATFORM_NUMICRO_QSPI_NO_DEINIT
	bool
	default y if PLATFORM_NUMICRO_NO_DEINIT
	depends on PLATFORM_NUMICRO_QSPI_BASE

config PLATFORM_NUMICRO_QSPI_PM
	bool "Power management"
	default n
	depends on PLATFORM_NUMICRO_QSPI_BASE && PM

config PLATFORM_NUMICRO_QSPI_RC
	bool "Runtime configuration"
	default y
	depends on PLATFORM_NUMICRO_QSPI_BASE

config PLATFORM_NUMICRO_QSPI
	bool "QSPI Master with DMA"
	default y
	depends on PLATFORM_NUMICRO_QSPI_BASE && PLATFORM_NUMICRO_PDMA

config PLATFORM_USB
	bool "USB"
	default y

config PLATFORM_USB_NO_DEINIT
	bool
	default y if PLATFORM_NUMICRO_NO_DEINIT
	depends on PLATFORM_USB

config PLATFORM_USB_DEVICE
	bool "USB Device"
	default y
	depends on PLATFORM_USB

config PLATFORM_USB_DEVICE_EP_REQUESTS
	int "Endpoint queue size"
	default 4
	depends on PLATFORM_USB_DEVICE

config PLATFORM_USB_HS
	bool
	default y if FAMILY_M48X
	depends on PLATFORM_USB
	select USB_DEVICE_HS
	help
	  This enables support for USB High Speed mode.

config PLATFORM_USB_DEVICE_EP_COUNT
	int
	default 8 if FAMILY_M03X
	default 12 if FAMILY_M48X
	depends on PLATFORM_USB_DEVICE

config PLATFORM_NUMICRO_WDT
	bool "Watchdog"
	default y

endmenu

if FAMILY_M03X
	source "platform/numicro/m03x/Kconfig"
endif

if FAMILY_M48X
	source "platform/numicro/m48x/Kconfig"
endif
```

## platform/numicro/m03x/Kconfig
```kconfig
menu "Enabled peripherals"

menu "BPWM"

config PLATFORM_NUMICRO_BPWM0
	bool "BPWM0"
	default y
	depends on PLATFORM_NUMICRO_BPWM_BASE

config PLATFORM_NUMICRO_BPWM1
	bool "BPWM1"
	default y
	depends on PLATFORM_NUMICRO_BPWM_BASE

endmenu

menu "I2C"

config PLATFORM_NUMICRO_I2C0
	bool "I2C0"
	default y
	depends on PLATFORM_NUMICRO_I2C_BASE

config PLATFORM_NUMICRO_I2C1
	bool "I2C1"
	default y
	depends on PLATFORM_NUMICRO_I2C_BASE

endmenu

menu "UART"

config PLATFORM_NUMICRO_UART0
	bool "UART0"
	default y
	depends on PLATFORM_NUMICRO_UART_BASE

config PLATFORM_NUMICRO_UART1
	bool "UART1"
	default y
	depends on PLATFORM_NUMICRO_UART_BASE

config PLATFORM_NUMICRO_UART2
	bool "UART2"
	default y
	depends on PLATFORM_NUMICRO_UART_BASE

config PLATFORM_NUMICRO_UART3
	bool "UART3"
	default y
	depends on PLATFORM_NUMICRO_UART_BASE

config PLATFORM_NUMICRO_UART4
	bool "UART4"
	default y
	depends on PLATFORM_NUMICRO_UART_BASE

config PLATFORM_NUMICRO_UART5
	bool "UART5"
	default y
	depends on PLATFORM_NUMICRO_UART_BASE

config PLATFORM_NUMICRO_UART6
	bool "UART6"
	default y
	depends on PLATFORM_NUMICRO_UART_BASE

config PLATFORM_NUMICRO_UART7
	bool "UART7"
	default y
	depends on PLATFORM_NUMICRO_UART_BASE

endmenu

menu "USB"

config PLATFORM_NUMICRO_USB_FS
	bool "FS USB"
	default y
	depends on PLATFORM_USB

endmenu

endmenu
```

## platform/numicro/m48x/Kconfig
```kconfig
menu "Enabled peripherals"

menu "BPWM"

config PLATFORM_NUMICRO_BPWM0
	bool "BPWM0"
	default y
	depends on PLATFORM_NUMICRO_BPWM_BASE

config PLATFORM_NUMICRO_BPWM1
	bool "BPWM1"
	default y
	depends on PLATFORM_NUMICRO_BPWM_BASE

endmenu

menu "CAN"

config PLATFORM_NUMICRO_CAN0
	bool "CAN0"
	default y
	depends on PLATFORM_NUMICRO_CAN

config PLATFORM_NUMICRO_CAN1
	bool "CAN1"
	default y
	depends on PLATFORM_NUMICRO_CAN

config PLATFORM_NUMICRO_CAN2
	bool "CAN2"
	default y
	depends on PLATFORM_NUMICRO_CAN

endmenu

menu "EADC"

config PLATFORM_NUMICRO_EADC0
	bool "EADC0"
	default y
	depends on PLATFORM_NUMICRO_EADC_BASE

config PLATFORM_NUMICRO_EADC1
	bool "EADC1"
	default y
	depends on PLATFORM_NUMICRO_EADC_BASE

endmenu

menu "I2C"

config PLATFORM_NUMICRO_I2C0
	bool "I2C0"
	default y
	depends on PLATFORM_NUMICRO_I2C_BASE

config PLATFORM_NUMICRO_I2C1
	bool "I2C1"
	default y
	depends on PLATFORM_NUMICRO_I2C_BASE

config PLATFORM_NUMICRO_I2C2
	bool "I2C2"
	default y
	depends on PLATFORM_NUMICRO_I2C_BASE

endmenu

menu "SDH"

config PLATFORM_NUMICRO_SDH0
	bool "SDH0"
	default y
	depends on PLATFORM_NUMICRO_SDH

config PLATFORM_NUMICRO_SDH1
	bool "SDH1"
	default y
	depends on PLATFORM_NUMICRO_SDH

endmenu

menu "SPI"

config PLATFORM_NUMICRO_SPI0
	bool "SPI0"
	default y
	depends on PLATFORM_NUMICRO_SPI_BASE

config PLATFORM_NUMICRO_SPI1
	bool "SPI1"
	default y
	depends on PLATFORM_NUMICRO_SPI_BASE

config PLATFORM_NUMICRO_SPI2
	bool "SPI2"
	default y
	depends on PLATFORM_NUMICRO_SPI_BASE

config PLATFORM_NUMICRO_SPI3
	bool "SPI3"
	default y
	depends on PLATFORM_NUMICRO_SPI_BASE

endmenu

menu "QSPI"

config PLATFORM_NUMICRO_QSPI0
	bool "QSPI0"
	default y
	depends on PLATFORM_NUMICRO_QSPI_BASE

config PLATFORM_NUMICRO_QSPI1
	bool "QSPI1"
	default y
	depends on PLATFORM_NUMICRO_QSPI_BASE

endmenu

menu "UART"

config PLATFORM_NUMICRO_UART0
	bool "UART0"
	default y
	depends on PLATFORM_NUMICRO_UART_BASE

config PLATFORM_NUMICRO_UART1
	bool "UART1"
	default y
	depends on PLATFORM_NUMICRO_UART_BASE

config PLATFORM_NUMICRO_UART2
	bool "UART2"
	default y
	depends on PLATFORM_NUMICRO_UART_BASE

config PLATFORM_NUMICRO_UART3
	bool "UART3"
	default y
	depends on PLATFORM_NUMICRO_UART_BASE

config PLATFORM_NUMICRO_UART4
	bool "UART4"
	default y
	depends on PLATFORM_NUMICRO_UART_BASE

config PLATFORM_NUMICRO_UART5
	bool "UART5"
	default y
	depends on PLATFORM_NUMICRO_UART_BASE

config PLATFORM_NUMICRO_UART6
	bool "UART6"
	default y
	depends on PLATFORM_NUMICRO_UART_BASE

config PLATFORM_NUMICRO_UART7
	bool "UART7"
	default y
	depends on PLATFORM_NUMICRO_UART_BASE

endmenu

menu "USB"

config PLATFORM_NUMICRO_USB_FS
	bool "FS USB"
	default y
	depends on PLATFORM_USB

config PLATFORM_NUMICRO_USB_HS
	bool "HS USB"
	default y
	depends on PLATFORM_USB

endmenu

endmenu
```
