## Kconfig
```kconfig
choice
	prompt "Processor core"
	default CORE_X86_64

	config CORE_X86
		bool "x86"

	config CORE_X86_64
		bool "x86_64"

	config CORE_CORTEX_M0
		bool "Cortex-M0"

	config CORE_CORTEX_M3
		bool "Cortex-M3"

	config CORE_CORTEX_M4
		bool "Cortex-M4"

	config CORE_CORTEX_M7
		bool "Cortex-M7"
endchoice

choice
	prompt "Processor family"
	default FAMILY_GENERIC_POSIX

	config FAMILY_GENERIC_POSIX
		bool "Generic POSIX"
		depends on CORE_X86 || CORE_X86_64

	config FAMILY_IMXRT106X
		bool "NXP i.MX RT106x"
		depends on CORE_CORTEX_M7

	config FAMILY_LPC11XX
		bool "NXP LPC11xx"
		depends on CORE_CORTEX_M0

	config FAMILY_LPC11EXX
		bool "NXP LPC11Exx"
		depends on CORE_CORTEX_M0

	config FAMILY_LPC13XX
		bool "NXP LPC13xx"
		depends on CORE_CORTEX_M3

	config FAMILY_LPC13UXX
		bool "NXP LPC13Uxx"
		depends on CORE_CORTEX_M3

	config FAMILY_LPC17XX
		bool "NXP LPC175x and LPC176x"
		depends on CORE_CORTEX_M3

	config FAMILY_LPC43XX_M4
		bool "NXP LPC43xx"
		select FAMILY_LPC43XX
		depends on CORE_CORTEX_M4

	config FAMILY_LPC43XX_M0APP
		bool "NXP LPC43xx M0APP"
		select FAMILY_LPC43XX
		depends on CORE_CORTEX_M0

	config FAMILY_LPC43XX_M0SUB
		bool "NXP LPC43xx M0SUB"
		select FAMILY_LPC43XX
		depends on CORE_CORTEX_M0

	config FAMILY_M03X
		bool "Nuvoton M03x"
		depends on CORE_CORTEX_M0

	config FAMILY_M48X
		bool "Nuvoton M48x"
		depends on CORE_CORTEX_M4

	config FAMILY_STM32F0XX
		bool "ST STM32F0xx"
		depends on CORE_CORTEX_M0

	config FAMILY_STM32F1XX
		bool "ST STM32F1xx"
		depends on CORE_CORTEX_M3

	config FAMILY_STM32F4XX
		bool "ST STM32F4xx"
		depends on CORE_CORTEX_M4
endchoice

config FAMILY_LPC43XX
	bool
	default y
	depends on FAMILY_LPC43XX_M4 || FAMILY_LPC43XX_M0APP || FAMILY_LPC43XX_M0SUB

menu "Core settings"

source "core/Kconfig"

endmenu

menu "Peripheral drivers"

source "generic/Kconfig"
source "platform/Kconfig"
source "usb/Kconfig"

endmenu
```

## core/Kconfig
```kconfig
if CORE_X86 || CORE_X86_64
	source "core/x86/Kconfig"
endif

if CORE_CORTEX_M0 || CORE_CORTEX_M0P || CORE_CORTEX_M3 || CORE_CORTEX_M4 || CORE_CORTEX_M7
	source "core/cortex/Kconfig"
endif

if CORE_RISCV
	source "core/riscv/Kconfig"
endif
```

## core/cortex/Kconfig
```kconfig
config CORE_CORTEX_HAS_SYSTICK
	bool
	default y if !FAMILY_LPC43XX_M0APP && !FAMILY_LPC43XX_M0SUB

config CORE_CORTEX_NO_DEINIT
	bool "Disable destructors"
	default n

config CORE_CORTEX_CACHE_LINE
	int
	default 32 if FAMILY_IMXRT106X
	depends on CORE_CORTEX_M7

config CORE_CORTEX_DCACHE
	bool "Enable D-Cache"
	default y
	depends on CORE_CORTEX_M7
	help
	  This enables Data Cache usage.

config CORE_CORTEX_DCACHE_WT
	bool "D-Cache Write-Through"
	default n
	depends on CORE_CORTEX_DCACHE
	help
	  This enables Write-Through mode for the Data Cache.

config CORE_CORTEX_ICACHE
	bool "Enable I-Cache"
	default y
	depends on CORE_CORTEX_M7
	help
	  This enables Instruction Cache usage.

config CORE_CORTEX_FPU
	bool "FPU"
	default y
	depends on CORE_CORTEX_M4 || CORE_CORTEX_M7
	help
	  This enables Floating Point Unit.

config CORE_CORTEX_MEMORY_DEBUG
	bool "Memory debug"
	default n
	help
	  This fills the RAM with a predefined pattern.

config CORE_CORTEX_MEMORY_PATTERN
	hex "Memory pattern"
	default 0xDEADBEEF
	range 0x00000000 0xFFFFFFFF
	depends on CORE_CORTEX_MEMORY_DEBUG

config CORE_CORTEX_SYSTICK
	bool "SysTick"
	default y
	depends on CORE_CORTEX_HAS_SYSTICK
	help
	  This is the driver for the System Timer peripheral.

config CORE_CORTEX_SYSTICK_NO_DEINIT
	bool
	default y if CORE_CORTEX_NO_DEINIT
	depends on CORE_CORTEX_SYSTICK
```

## core/cortex/kconfig
```kconfig
config CORE
	string
	default m0 if CORE_CORTEX_M0
	default m3 if CORE_CORTEX_M3
	default m4 if CORE_CORTEX_M4

config CORE_TYPE
	string
	default cortex if CORE_CORTEX_M0 || CORE_CORTEX_M3 || CORE_CORTEX_M4

config FPU
	bool "FPU"
	default y
	help
	  This enables Floating Point Unit.
	depends on CORE_CORTEX_M4

config CORE_CORTEX_SYSTICK
	bool "SysTick"
	default y
	help
	  This is the driver for the System Timer peripheral.
	depends on CORE_CORTEX_M0 || CORE_CORTEX_M3 || CORE_CORTEX_M4
```

## core/intel/kconfig
```kconfig
config CORE
	string
	default x86 if CORE_X86
	default x86_64 if CORE_X86_64

config CORE_TYPE
	string
	default intel
```

## core/kconfig
```kconfig
if CORE_X86 || CORE_X86_64
	source "core/intel/kconfig"
endif

if CORE_CORTEX_M0 || CORE_CORTEX_M3 || CORE_CORTEX_M4
	source "core/cortex/kconfig"
endif
```

## core/riscv/Kconfig
```kconfig
config CORE_RISCV_NO_DEINIT
	bool "Disable destructors"
	default n

config CORE_RISCV_FPU
	bool "FPU"
	default n
	help
	  This enables Floating Point Unit.

config CORE_RISCV_MEMORY_DEBUG
	bool "Memory debug"
	default n
	help
	  This fills the RAM with a predefined pattern.

config CORE_RISCV_MEMORY_PATTERN
	hex "Memory pattern"
	default 0xDEADBEEF
	range 0x00000000 0xFFFFFFFF
	depends on CORE_RISCV_MEMORY_DEBUG

config CORE_RISCV_MACHINE_TIMER
	bool "Machine Timer"
	default y
	help
	  This is the driver for the Machine Timer peripheral.

config CORE_RISCV_MACHINE_TIMER_NO_DEINIT
	bool
	default y if CORE_RISCV_NO_DEINIT
	depends on CORE_RISCV_MACHINE_TIMER
```

## generic/Kconfig
```kconfig
menu "Generic drivers"

config GENERIC_BUFFERING_PROXY
	bool "Buffering proxy"
	default y
	help
	  This enables building of a synchronous buffered interface that wraps
	  an asynchronous interface with input and output streams.

config GENERIC_GPIO_BUS
	bool "GPIO Bus"
	default y

config GENERIC_MMCSD
	bool "MMC/SD cards"
	default y

config GENERIC_RAM_PROXY
	bool "RAM proxy"
	default y
	help
	  This enables building of an interface that implements read and write
	  functions along with stubs for generic flash memory operation
	  for a selected RAM region.

config GENERIC_SDIO_SPI
	bool "SDIO over SPI"
	default y

config GENERIC_SDIO_SPI_CRC
	bool "Enable CRC checking"
	default y
	depends on GENERIC_SDIO_SPI

config GENERIC_SOFTWARE_TIMER_32
	bool "Extending 32-bit timer"
	default y

config GENERIC_SOFTWARE_TIMER_64
	bool "Extending 64-bit timer"
	default y

config GENERIC_TIMER_FACTORY
	bool "Software Timer Factory"
	default y

config GENERIC_WQ
	bool "Work Queue"
	default y

config GENERIC_WQ_LOAD
	bool "Gather performance data"
	default n
	depends on GENERIC_WQ
	help
	  This enables calculation of the idle cycles of the work queue.
	  The number of idle cycles depends on the processor load.
	  Power management is disabled in this mode.

config GENERIC_WQ_NONSTOP
	bool "Disable stop functions"
	default n
	depends on GENERIC_WQ

config GENERIC_WQ_PM
	bool "Enable power management"
	default y
	depends on GENERIC_WQ

config GENERIC_WQ_PROFILE
	bool "Enable profiling support"
	default n
	depends on GENERIC_WQ
	help
	  This enables support for profiling and statistics functions.
	  Information about task execution times and latency will be available.

config GENERIC_WQ_IRQ
	bool "Work Queue on IRQ"
	default y

config GENERIC_WQ_IRQ_NONSTOP
	bool "Disable stop functions"
	default n
	depends on GENERIC_WQ_IRQ

config GENERIC_WQ_IRQ_PROFILE
	bool "Enable profiling support"
	default n
	depends on GENERIC_WQ_IRQ
	help
	  This enables support for profiling and statistics functions.
	  Information about task execution times and latency will be available.

config GENERIC_WQ_UNIQUE
	bool "Unique Work Queue"
	default y

config GENERIC_WQ_UNIQUE_LOAD
	bool "Gather performance data"
	default n
	depends on GENERIC_WQ_UNIQUE
	help
	  This enables calculation of the idle cycles of the work queue.
	  The number of idle cycles depends on the processor load.
	  Power management is disabled in this mode.

config GENERIC_WQ_UNIQUE_NONSTOP
	bool "Disable stop functions"
	default n
	depends on GENERIC_WQ_UNIQUE

config GENERIC_WQ_UNIQUE_PM
	bool "Enable power management"
	default y
	depends on GENERIC_WQ_UNIQUE

config GENERIC_WQ_UNIQUE_PROFILE
	bool "Enable profiling support"
	default n
	depends on GENERIC_WQ_UNIQUE
	help
	  This enables support for profiling and statistics functions.
	  Information about task execution times and latency will be available.

endmenu
```

## generic/kconfig
```kconfig
menu "Generic drivers"

config GENERIC_GPIO_BUS
	bool "GPIO Bus"
	default y

config GENERIC_SDIO_SPI
	bool "SDIO over SPI"
	default y

config GENERIC_SDIO_SPI_CRC
	bool "Enable CRC checking"
	default y
	depends on GENERIC_SDIO_SPI

config GENERIC_SDCARD
	bool "SD Card driver"
	default y

config GENERIC_WORK_QUEUE
	bool "Work Queue"
	default y

endmenu
```

## kconfig
```kconfig
choice
	prompt "Processor core"
	default CORE_CORTEX_M0

	config CORE_CORTEX_M0
		bool "Cortex-M0"

	config CORE_CORTEX_M3
		bool "Cortex-M3"

	config CORE_CORTEX_M4
		bool "Cortex-M4"
endchoice

choice
	prompt "Processor family"
	default FAMILY_LPC11XX

	config FAMILY_LPC11XX
		bool "NXP LPC11xx"
		depends on CORE_CORTEX_M0

	config FAMILY_LPC11EXX
		bool "NXP LPC11Exx"
		depends on CORE_CORTEX_M0

	config FAMILY_LPC13XX
		bool "NXP LPC13xx"
		depends on CORE_CORTEX_M3

	config FAMILY_LPC17XX
		bool "NXP LPC175x and LPC176x"
		depends on CORE_CORTEX_M3

	config FAMILY_LPC43XX
		bool "NXP LPC43xx"
		depends on CORE_CORTEX_M4

	config FAMILY_STM32F1XX
		bool "ST STM32F1xx"
		depends on CORE_CORTEX_M3
endchoice

menu "Core settings"

source "core/kconfig"

endmenu

menu "Peripheral drivers"

source "generic/kconfig"
source "platform/kconfig"
source "usb/kconfig"

endmenu

menu "Build options"

choice
	prompt "Optimization level"
	default OPTIMIZATIONS_DISABLED

	config OPTIMIZATIONS_DISABLED
		bool "None"

	config OPTIMIZATIONS_SIZE
		bool "Size"

	config OPTIMIZATIONS_FULL
		bool "Full"

	config OPTIMIZATIONS_DEBUG
		bool "Debug"
endchoice

config ASSERTIONS
	bool "Enable assertions"
	depends on (OPTIMIZATIONS_DISABLED || OPTIMIZATIONS_DEBUG)
	default y

config LTO
	bool "Link Time Optimization"
	depends on (OPTIMIZATIONS_SIZE || OPTIMIZATIONS_FULL)
	default y

endmenu
```

## platform/Kconfig
```kconfig
if FAMILY_GENERIC_POSIX
	source "platform/generic/Kconfig"
endif

if FAMILY_IMXRT106X
	source "platform/imxrt/Kconfig"
endif

if FAMILY_LPC11XX || FAMILY_LPC11EXX || FAMILY_LPC13XX || FAMILY_LPC13UXX || FAMILY_LPC17XX || FAMILY_LPC43XX
	source "platform/lpc/Kconfig"
endif

if FAMILY_M03X || FAMILY_M48X
	source "platform/numicro/Kconfig"
endif

if FAMILY_STM32F0XX || FAMILY_STM32F1XX || FAMILY_STM32F4XX
	source "platform/stm32/Kconfig"
endif
```

## platform/bouffalo/Kconfig
```kconfig
menu "Power settings"

config PM
	bool "Power management"
	default y
	help
	  This enables support for power management features.

endmenu

menu "Peripherals"

config PLATFORM_BOUFFALO_NO_DEINIT
	bool "Disable destructors"
	default n

config PLATFORM_BOUFFALO_DMA
	bool "DMA"
	default y

config PLATFORM_BOUFFALO_DMA_PRIORITY
	int "DMA interrupts priority"
	default 0
	depends on PLATFORM_BOUFFALO_DMA

config PLATFORM_BOUFFALO_DMA_SYNC
	bool "DMA synchronization"
	default y
	depends on PLATFORM_BOUFFALO_DMA
	help
	  Synchronization logic must be enabled when peripherals
	  generating DMA requests run on different clocks to the GPDMA.
	  For peripherals  running on the same clock as the GPDMA,
	  disabling the synchronization logic improves the DMA request
	  response time.

config PLATFORM_BOUFFALO_GPTIMER_BASE
	bool "General Purpose Timer"
	default y

config PLATFORM_BOUFFALO_GPTIMER_NO_DEINIT
	bool
	default y if PLATFORM_BOUFFALO_NO_DEINIT
	depends on PLATFORM_BOUFFALO_GPTIMER_BASE

config PLATFORM_BOUFFALO_GPTIMER_PM
	bool "Power management"
	default n
	depends on PLATFORM_BOUFFALO_GPTIMER_BASE && PM

config PLATFORM_BOUFFALO_GPTIMER
	bool "Common timer"
	default y
	depends on PLATFORM_BOUFFALO_GPTIMER_BASE

choice
	prompt "Instruction Cache size"
	default PLATFORM_BOUFFALO_ICACHE_NONE

	config PLATFORM_BOUFFALO_ICACHE_NONE
		bool "Disabled"

	config PLATFORM_BOUFFALO_ICACHE_8K
		bool "8K"

	config PLATFORM_BOUFFALO_ICACHE_16K
		bool "16K"

	config PLATFORM_BOUFFALO_ICACHE_24K
		bool "24K"

	config PLATFORM_BOUFFALO_ICACHE_32K
		bool "32K"
endchoice

config PLATFORM_BOUFFALO_UART_BASE
	bool "UART"
	default y

config PLATFORM_BOUFFALO_UART_NO_DEINIT
	bool
	default y if PLATFORM_BOUFFALO_NO_DEINIT
	depends on PLATFORM_BOUFFALO_UART_BASE

config PLATFORM_BOUFFALO_UART_PM
	bool "Power management"
	default n
	depends on PM && PLATFORM_BOUFFALO_UART_BASE

config PLATFORM_BOUFFALO_UART_RC
	bool "Runtime configuration"
	default y
	depends on PLATFORM_BOUFFALO_UART_BASE

config PLATFORM_BOUFFALO_UART_WATERMARK
	bool "Watermark calculation"
	default n
	depends on PLATFORM_BOUFFALO_UART_BASE

config PLATFORM_BOUFFALO_SERIAL
	bool "Interrupt-driven serial port driver"
	default y
	depends on PLATFORM_BOUFFALO_UART_BASE

config PLATFORM_BOUFFALO_SERIAL_DMA
	bool "Serial port driver with DMA"
	default y
	depends on PLATFORM_BOUFFALO_UART_BASE && PLATFORM_BOUFFALO_DMA

endmenu
```

## platform/generic/Kconfig
```kconfig
menu "Interfaces"

config PLATFORM_LINUX_CONSOLE
	bool "Console"
	default y

config PLATFORM_LINUX_MMF
	bool "Memory mapped file"
	default y

config PLATFORM_LINUX_RTC
	bool "RTC"
	default y

config PLATFORM_LINUX_SERIAL
	bool "Serial stream"
	default y

config PLATFORM_LINUX_SIGNAL_HANDLER
	bool "Signal Handler"
	default y

config PLATFORM_LINUX_TIMER
	bool "Timer"
	default y

config PLATFORM_LINUX_UDP
	bool "UDP stream"
	default y

config PLATFORM_LINUX_WQ
	bool "Work Queue"
	default y

endmenu
```

## platform/imxrt/Kconfig
```kconfig
menu "Power settings"

config PM
	bool "Power management"
	default y
	help
	  This enables support for power management features.

endmenu

menu "Peripherals"

config PLATFORM_IMXRT_NO_DEINIT
	bool "Disable destructors"
	default n

config PLATFORM_IMXRT_EDMA
	bool "EDMA"
	default y

config PLATFORM_IMXRT_EDMA_PRIORITY
	int "EDMA interrupts priority"
	default 0
	depends on PLATFORM_IMXRT_EDMA

config PLATFORM_IMXRT_LPUART_BASE
	bool "UART"
	default y

config PLATFORM_IMXRT_LPUART_NO_DEINIT
	bool
	default y if PLATFORM_IMXRT_NO_DEINIT
	depends on PLATFORM_IMXRT_LPUART_BASE

config PLATFORM_IMXRT_LPUART_PM
	bool "Power management"
	default n
	depends on PM && PLATFORM_IMXRT_LPUART_BASE

config PLATFORM_IMXRT_LPUART_RC
	bool "Runtime configuration"
	default y
	depends on PLATFORM_IMXRT_LPUART_BASE

config PLATFORM_IMXRT_LPUART_WATERMARK
	bool "Watermark calculation"
	default n
	depends on PLATFORM_IMXRT_LPUART_BASE

config PLATFORM_IMXRT_PIT
	bool "PIT"
	default y
	help
	  This is the driver for the Periodic Interrupt Timer.

config PLATFORM_IMXRT_PIT_NO_DEINIT
	bool
	default y if PLATFORM_IMXRT_NO_DEINIT
	depends on PLATFORM_IMXRT_PIT

config PLATFORM_IMXRT_SERIAL
	bool "Interrupt-driven serial port driver"
	default y
	depends on PLATFORM_IMXRT_LPUART_BASE

config PLATFORM_IMXRT_SERIAL_DMA
	bool "Serial port driver with DMA"
	default y
	depends on PLATFORM_IMXRT_LPUART_BASE && PLATFORM_IMXRT_EDMA

config PLATFORM_USB
	bool "USB"
	default y
	select CORE_CORTEX_MPU if CORE_CORTEX_DCACHE

config PLATFORM_USB_NO_DEINIT
	bool
	default y if PLATFORM_IMXRT_NO_DEINIT
	depends on PLATFORM_USB

config PLATFORM_USB_HS
	bool "USB HS"
	default y
	depends on PLATFORM_USB
	select USB_DEVICE_HS
	help
	  This enables support for USB High Speed mode.

config PLATFORM_USB_SOF
	bool "USB SOF"
	default y
	depends on PLATFORM_USB
	help
	  This enables support for USB Start of Frame events.

config PLATFORM_USB_DEVICE
	bool "USB Device"
	default y
	depends on PLATFORM_USB

config PLATFORM_USB_DEVICE_POOL_SIZE
	int "Descriptor pool size"
	default 32
	depends on PLATFORM_USB_DEVICE

endmenu
```

## platform/kconfig
```kconfig
if FAMILY_LPC11XX || FAMILY_LPC11EXX || FAMILY_LPC13XX || FAMILY_LPC17XX || FAMILY_LPC43XX
	source "platform/nxp/kconfig"
endif

if FAMILY_STM32F1XX
	source "platform/stm/kconfig"
endif
```
